## meta-sonicpi/conf/layer.conf
```bitbake
# We have a conf and classes directory, add to BBPATH
BBPATH .= ":${LAYERDIR}"

# We have recipes-* directories, add to BBFILES
BBFILES += "${LAYERDIR}/recipes-*/*/*.bb \
            ${LAYERDIR}/recipes-*/*/*.bbappend"

BBFILE_COLLECTIONS += "foo"
BBFILE_PATTERN_foo = "^${LAYERDIR}/"
BBFILE_PRIORITY_foo = "6"

LAYERDEPENDS_foo = "core"
LAYERSERIES_COMPAT_foo = "warrior"
```
